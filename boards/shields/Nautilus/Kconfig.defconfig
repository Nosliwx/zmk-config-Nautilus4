## boards/shields/Nautilus/Kconfig.defconfig
```kconfig
# Required files for ZMK to recognize the shield

if SHIELD_NAUTILUS

# Name must be less than 16 characters long!
config ZMK_KEYBOARD_NAME
    default "Nautilus"

endif
```
